/**
 * @file User_timer.cpp
 * @brief WiFi connection, time sync, weather API and icon data
 * @author PAUL
 * @date 2026-03
 */

#include "User_timer.h"

//============================================================
//                      Configuration
//============================================================

const char* WIFI_SSID     = "601";
const char* WIFI_PASS     = "Cgb84703318";
const char* SENI_KEY      = "SfKpR_iDEf5ikGkOA";
const char* LOCATION      = "101210901";
const int UPDATE_INTERVAL = 300000;

//============================================================
//                      Global Variables
//============================================================

String loc_name1;
String now_text1;
String now_code1;
String now_temp1;
String last_update1;

String text_day1;
String text_night1;
String temp1;
String humidity1;
String wind_scale1;

String text_day2;
String text_night2;
String temp2;
String humidity2;
String wind_scale2;

//============================================================
//                      Weather Icons
//============================================================

const unsigned char icon_sun[] PROGMEM = {
0X00,0X00,0X00,0X00,0X00,0XFF,0X80,0X00,0X00,0X00,0X00,0X00,0X00,0X00,0X00,0X00,
0X07,0XFF,0XF8,0X00,0X00,0X00,0X00,0X00,0X00,0X00,0X00,0X01,0XFF,0XFF,0XFF,0XC0,
0X00,0X00,0X00,0X00,0X00,0X00,0X00,0X03,0XFF,0XFF,0XFF,0XF0,0X00,0X00,0X00,0X00,
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0X00,0X00,0X00,0X00,0X00
};

const unsigned char icon_cloud[] PROGMEM = {
0X00,0X00,0X00,0X00,0X00,0X00,0X3F,0X80,0X00,0X00,0X00,0X00,0X00,0X00,0X00,0X00,
0X00,0XFF,0XF0,0X00,0X00,0X00,0X00,0X00,0X00,0X00,0X00,0X07,0XFF,0XFC,0X00,0X00,
0X00,0X00,0X00,0X00,0X00,0X00,0X1F,0XFF,0XFF,0X00,0X00,0X00,0X00,0X00,0X00,0X00,
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0XFF,0XFF,0XF0,0X00
};

const unsigned char icon_Overcast[] PROGMEM = {
0X00,0X00,0X00,0X00,0X00,0X00,0X00,0X07,0XFF,0X00,0X00,0X00,0X00,0X00,0X00,0X00,
0X00,0X00,0X00,0X00,0X00,0X1F,0XFF,0XC0,0X00,0X00,0X00,0X00,0X00,0X00,0X00,0X00,
0X00,0X00,0X00,0XFF,0XFF,0XF8,0X00,0X00,0X00,0X00,0X00,0X00,0X00,0X00,0X00,0X00,
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0XFF,0XC0,0X00
};

const unsigned char icon_fog[] PROGMEM = {
0X00,0X00,0X00,0X00,0X00,0X00,0X00,0X00,0X00,0X00,0X00,0X00,0X00,0X00,0X00,0X00,
0X00,0X00,0X00,0X00,0X00,0X00,0X00,0X00,0X00,0X00,0X00,0X00,0X00,0X00,0X00,0X00,
0X00,0X00,0X00,0X00,0X00,0X00,0X00,0X00,0X00,0X00,0X00,0X00,0X00,0X00,0X00,0X00,
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0XFF,0XFF,0XFF,0XC0
};

const unsigned char icon_rain[] PROGMEM = {
0X00,0X00,0X00,0X00,0X00,0X00,0X00,0X07,0XFF,0X00,0X00,0X00,0X00,0X00,0X00,0X00,
0X00,0X00,0X00,0X00,0X00,0X1F,0XFF,0XC0,0X00,0X00,0X00,0X00,0X00,0X00,0X00,0X00,
0X00,0X00,0X00,0XFF,0XFF,0XF8,0X00,0X00,0X00,0X00,0X00,0X00,0X00,0X00,0X00,0X00,
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0XFF,0XC0,0X00
};

const unsigned char icon_snow[] PROGMEM = {
0X00,0X00,0X00,0X00,0X00,0X00,0X00,0X07,0XFF,0X00,0X00,0X00,0X00,0X00,0X00,0X00,
0X00,0X00,0X00,0X00,0X00,0X1F,0XFF,0XC0,0X00,0X00,0X00,0X00,0X00,0X00,0X00,0X00,
0X00,0X00,0X00,0XFF,0XFF,0XF8,0X00,0X00,0X00,0X00,0X00,0X00,0X00,0X00,0X00,0X00,
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0XFF,0XC0,0X00
};

//============================================================
//                      WiFi & NTP Functions
//============================================================

uint8_t syncNTPTime(void)
{
    Serial.begin(115200);
    DEBUG_PRINT("\nConnecting WiFi...");
    
    WiFi.begin(WIFI_SSID, WIFI_PASS);
    int wifiRetry = 0;
    while (WiFi.status() != WL_CONNECTED && wifiRetry < 20) {
        delay(500);
        DEBUG_PRINT(".");
        wifiRetry++;
    }

    if (WiFi.status() != WL_CONNECTED) {
        DEBUG_PRINTLN("\nWiFi connection failed!");
        return 0;
    }
    DEBUG_PRINTLN("\nWiFi connected");

    configTime(TIME_ZONE * 3600, 0, "ntp.aliyun.com", "time.ustc.edu.cn");
    
    time_t now = time(nullptr);
    int timeRetry = 0;
    while (now < 1600000000 && timeRetry < 20) {
        delay(500);
        now = time(nullptr);
        DEBUG_PRINT("\nSyncing time...");
        timeRetry++;
    }

    if (now >= 1600000000) {
        DEBUG_PRINTLN("\nTime sync complete");
    } else {
        DEBUG_PRINTLN("\nTime sync failed!");
    }
    
    return WiFi.channel();
}

void getCurrentTime(int& hour, int& minute, int& second)
{
    time_t now = time(nullptr);
    struct tm timeinfo = *localtime(&now);
    hour = timeinfo.tm_hour;
    minute = timeinfo.tm_min;
    second = timeinfo.tm_sec;
    DEBUG_PRINTF("\nCurrent time: %02d:%02d:%02d\n", hour, minute, second);
}

bool isNetworkReady()
{
    HTTPClient http;
    http.begin("http://www.baidu.com");
    http.setTimeout(3000);
    int code = http.GET();
    http.end();
    return (code == 200);
}

int WIFI_signal(void)
{
    if (WiFi.status() != WL_CONNECTED) {
        DEBUG_PRINTLN("\nWiFi not connected, cannot read signal strength");
        return 0;
    }

    int retry = 0;
    while (!isNetworkReady() && retry < 10) {
        DEBUG_PRINTF("\nWiFi connected but network not ready, retry %d/10...\n", retry + 1);
        delay(1000);
        retry++;
    }

    int rssi = WiFi.RSSI();
    DEBUG_PRINTF("\nWiFi signal strength (RSSI): %d dBm\n", rssi);
    
    return rssi;
}

//============================================================
//                      Weather API Functions
//============================================================

void User_getWeather_now(void)
{
    DEBUG_PRINTLN("\n===== Fetching weather data =====");
    if (WiFi.status() != WL_CONNECTED) {
        DEBUG_PRINTLN("\nWiFi not connected");
        return;
    }

    String url = "http://api.seniverse.com/v3/weather/now.json?"
                 "key=" + String(SENI_KEY) +
                 "&location=" + String(LOCATION) +
                 "&language=zh-Hans"
                 "&unit=c";

    HTTPClient http;
    DEBUG_PRINTLN(url);
    http.begin(url);
    http.setTimeout(10000);
    int httpCode = http.GET();

    if (httpCode == 200) {
        DEBUG_PRINTLN("\nResponse: 200 (Success)");
        String payload = http.getString();
        DEBUG_PRINTLN(payload);

        JsonDocument doc;
        DeserializationError error = deserializeJson(doc, payload);
        if (!error) {
            JsonObject location = doc["results"][0]["location"];
            loc_name1 = location["name"].as<String>();
            
            JsonObject now = doc["results"][0]["now"];
            now_text1 = now["text"].as<String>();
            now_code1 = now["code"].as<String>();
            now_temp1 = now["temperature"].as<String>() + "'C";
            last_update1 = doc["results"][0]["last_update"].as<String>();

            DEBUG_PRINTLN("===== Weather data parsed =====");
            DEBUG_PRINT("City: "); DEBUG_PRINTLN(loc_name1);
            DEBUG_PRINT("Weather: "); DEBUG_PRINTLN(now_text1);
            DEBUG_PRINT("Temp: "); DEBUG_PRINTLN(now_temp1);
        } else {
            DEBUG_PRINT("\nJSON parse failed: ");
            DEBUG_PRINTLN(error.c_str());
        }
    } else {
        DEBUG_PRINT("\nRequest failed, code: ");
        DEBUG_PRINTLN(httpCode);
    }
    http.end();
    DEBUG_PRINTLN("\n===== Weather fetch complete =====\n");
}

void User_getWeather_Daily(void)
{
    DEBUG_PRINTLN("\n===== Fetching weather forecast =====");
    if (WiFi.status() != WL_CONNECTED) {
        DEBUG_PRINTLN("\nWiFi not connected");
        return;
    }

    String url = "http://api.seniverse.com/v3/weather/daily.json?"
                 "key=" + String(SENI_KEY) +
                 "&location=" + String(LOCATION) +
                 "&language=zh-Hans"
                 "&unit=c"
                 "&start=1"
                 "&days=2";

    HTTPClient http;
    DEBUG_PRINTLN(url);
    http.begin(url);
    http.setTimeout(10000);
    int httpCode = http.GET();

    if (httpCode == 200) {
        DEBUG_PRINTLN("\nResponse: 200 (Success)");
        String payload = http.getString();
        DEBUG_PRINTLN(payload);

        JsonDocument doc;
        DeserializationError error = deserializeJson(doc, payload);
        if (!error) {
            JsonArray daily = doc["results"][0]["daily"];
            
            for (int i = 0; i < daily.size(); i++) {
                JsonObject day = daily[i];
                String text_day = day["text_day"].as<String>();
                String text_night = day["text_night"].as<String>();
                String high = day["high"].as<String>();
                String low = day["low"].as<String>();
                String wind_scale = day["wind_scale"].as<String>();
                String humidity = day["humidity"].as<String>();
                
                if (i == 0) {
                    text_day1 = text_day;
                    text_night1 = text_night;
                    temp1 = low + "~" + high + "'C";
                    humidity1 = humidity + "%";
                    wind_scale1 = wind_scale + " level";
                } else if (i == 1) {
                    text_day2 = text_day;
                    text_night2 = text_night;
                    temp2 = low + "~" + high + "'C";
                    humidity2 = humidity + "%";
                    wind_scale2 = wind_scale + " level";
                }
            }
            
            DEBUG_PRINTLN("===== Forecast data parsed =====");
        } else {
            DEBUG_PRINT("\nJSON parse failed: ");
            DEBUG_PRINTLN(error.c_str());
        }
    } else {
        DEBUG_PRINT("\nRequest failed, code: ");
        DEBUG_PRINTLN(httpCode);
    }
    http.end();
    DEBUG_PRINTLN("\n===== Forecast fetch complete =====\n");
}
